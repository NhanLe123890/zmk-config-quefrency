#include "quefrency.dtsi"

&default_transform {
    col-offset = <7>;
};

/* This kscan is for the 65% right half the 60% right half
 * may require different column and row pins
 */
&kscan0 {
    col-gpios = <&pro_micro 20 GPIO_ACTIVE_HIGH>,
                <&pro_micro 19 GPIO_ACTIVE_HIGH>,
                <&pro_micro 18 GPIO_ACTIVE_HIGH>,
                <&pro_micro 15 GPIO_ACTIVE_HIGH>,
                <&pro_micro 14 GPIO_ACTIVE_HIGH>,
                <&pro_micro 16 GPIO_ACTIVE_HIGH>,
                <&pro_micro 10 GPIO_ACTIVE_HIGH>,
                <&pro_micro 5  GPIO_ACTIVE_HIGH>;
};
