## config/Kconfig.shield
```kconfig
config SHIELD_QUEFRENCY_LEFT
    def_bool $(shields_list_contains,quefrency_left)

config SHIELD_QUEFRENCY_RIGHT
    def_bool $(shields_list_contains,quefrency_right)
```
